## lessons/03-meshfun/08-onoff-app/boards/nrf52840dk_nrf52840.conf
```kconfig
# on nrf52840dk_nrf52840 boards we have to configure Segger RTT

# some samples have small main stack size, which needs to be increased
CONFIG_MAIN_STACK_SIZE=2048

# configure Segger RTT
CONFIG_UART_CONSOLE=n
CONFIG_USE_SEGGER_RTT=y
CONFIG_RTT_CONSOLE=y
```
