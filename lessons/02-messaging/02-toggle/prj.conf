## CMakeLists.txt
```
# SPDX-License-Identifier: Apache-2.0

  cmake_minimum_required(VERSION 3.20.0)
  find_package(Zephyr REQUIRED HINTS $ENV{ZEPHYR_BASE})

#===============================================================================
# project personality (definitions to be pushed down to C-level)
#===============================================================================

  project(02-toggle)

  add_definitions(-DPROJECT="${CMAKE_PROJECT_NAME}")
  add_definitions(-DCFG_LOG_GEAR=0)

#===============================================================================
# path setup
#===============================================================================

  set (LIB ../../../lib/v1.1.0)        # library path
  set (BLU ${LIB}/bluccino)            # Bluccino library modules
  set (HWC ${LIB}/core/hwcore/hwtiny)  # tiny hardware core
  set (SRC src)

  include_directories(${SRC} ${BLU} ${HWC})

#===============================================================================
# source files
#===============================================================================

  target_sources(app PRIVATE
    ${SRC}/main.c
    ${BLU}/bluccino.c
    ${HWC}/bl_hw.c
  )
```

## prj.conf
```kconfig
#CONFIG_INIT_STACKS=y      # if set, lots of noise from mesh/adv.c: STACK_ANALYZE
CONFIG_MAIN_STACK_SIZE=2048
CONFIG_SYSTEM_WORKQUEUE_STACK_SIZE=2048

CONFIG_GPIO=y

CONFIG_BT_SETTINGS=y
CONFIG_FLASH=y
CONFIG_FLASH_PAGE_LAYOUT=y
CONFIG_FLASH_MAP=y
CONFIG_NVS=y
CONFIG_SETTINGS=y
CONFIG_BT_MESH_RPL_STORE_TIMEOUT=600

CONFIG_BOOT_BANNER=y

CONFIG_BT_OBSERVER=y
CONFIG_BT_BROADCASTER=y
CONFIG_BT_CTLR_DUP_FILTER_LEN=0
CONFIG_BT_CTLR_LE_ENC=n
CONFIG_BT_CTLR_LE_PING=n
CONFIG_BT_DATA_LEN_UPDATE=n
CONFIG_BT_PHY_UPDATE=n
CONFIG_BT_CTLR_CHAN_SEL_2=n
CONFIG_BT_CTLR_MIN_USED_CHAN=n
CONFIG_BT_CTLR_ADV_EXT=n
CONFIG_BT_CTLR_PRIVACY=n

CONFIG_BT_PERIPHERAL=y

CONFIG_BT=y
CONFIG_BT_TINYCRYPT_ECC=y
CONFIG_BT_L2CAP_TX_BUF_COUNT=8

CONFIG_BT_MESH=y
CONFIG_BT_MESH_RELAY=y
CONFIG_BT_MESH_RELAY_ENABLED=n
CONFIG_BT_MESH_BEACON_ENABLED=n
CONFIG_BT_MESH_LOW_POWER=n
CONFIG_BT_MESH_FRIEND=n
CONFIG_BT_MESH_FRIEND_QUEUE_SIZE=16
CONFIG_BT_MESH_ADV_BUF_COUNT=20
CONFIG_BT_MESH_TX_SEG_MAX=6

CONFIG_BT_MESH_PB_GATT=y
CONFIG_BT_MESH_PB_ADV=y
CONFIG_BT_MESH_GATT_PROXY=y
CONFIG_BT_MESH_CFG_CLI=y

#CONFIG_BT_MESH_LPN_SCAN_LATENCY=30
#CONFIG_BT_MESH_LPN_RECV_DELAY=40
#CONFIG_BT_MESH_LPN_POLL_TIMEOUT=300

CONFIG_BT_MESH_SUBNET_COUNT=2
CONFIG_BT_MESH_APP_KEY_COUNT=2
CONFIG_BT_MESH_MODEL_KEY_COUNT=2
CONFIG_BT_MESH_MODEL_GROUP_COUNT=2
CONFIG_BT_MESH_LABEL_COUNT=3

#CONFIG_BT_MESH_IV_UPDATE_TEST=y

CONFIG_UART_CONSOLE=y

# this outputs btmon formatted data to the serial port
#CONFIG_BT_DEBUG_MONITOR_UART=y

CONFIG_BT_DEBUG_LOG=y

CONFIG_BT_MESH_DEBUG=y
#CONFIG_BT_MESH_DEBUG_PROV=y
#CONFIG_BT_MESH_DEBUG_PROXY=y
#CONFIG_BT_MESH_DEBUG_BEACON=y
#CONFIG_BT_MESH_DEBUG_NET=y
#CONFIG_BT_MESH_DEBUG_TRANS=y
#CONFIG_BT_MESH_DEBUG_LOW_POWER=y
#CONFIG_BT_MESH_DEBUG_FRIEND=y
#CONFIG_BT_MESH_DEBUG_MODEL=y
#CONFIG_BT_MESH_DEBUG_ACCESS=y
#CONFIG_BT_MESH_DEBUG_CRYPTO=y
#CONFIG_BT_MESH_DEBUG_ADV=y
#CONFIG_BT_MESH_SELF_TEST=y

#CONFIG_BT_HCI_VS_EXT=n

#CONFIG_STACK_USAGE=y

CONFIG_BT_RX_STACK_SIZE=4096

#CONFIG_BT_DEBUG_HCI_DRIVER=y
#CONFIG_BT_DEBUG_HCI_CORE=y
#CONFIG_BT_DEBUG_GATT=y
#CONFIG_BT_DEBUG_CONN=y

CONFIG_BT_MAX_CONN=1
CONFIG_BT_CTLR_RX_BUFFERS=6
CONFIG_BT_BUF_ACL_TX_COUNT=4
CONFIG_BT_BUF_CMD_TX_COUNT=4

CONFIG_BT_ATT_PREPARE_COUNT=2

#CONFIG_NET_BUF_SIMPLE_LOG=y
#CONFIG_NET_BUF_LOG=y
#CONFIG_BT_CTLR_DEBUG_PINS=y

# iHux: added for Segger RTT
CONFIG_USE_SEGGER_RTT=y
CONFIG_RTT_CONSOLE=y
CONFIG_UART_CONSOLE=n
CONFIG_LOG_BUFFER_SIZE=4096
```

## src/main.c
```c
//==============================================================================
// main.c for 02-toggle (tiny LED toggle control)
//==============================================================================
//
// toggle control
//                           +-------------+
//             BUTTON:PRESS  |             |     LED:SET
//       (U)---------------->|     app     |---------------->(D)
//                 @ix       |             |    @ix,onoff
//                           +-------------+
//
//           bl_up                 app                 bl_down
//            (U)                  (A)                  (D)
//             |                    |                    |
//             |    BUTTON:PRESS    |                    |
//             o------------------->|                    |
//             |         @ix        |                    |
//             |          +---------v---------+          |
//             |          | onoff[@ix]        |          |
//             |          |    = !onoff[@ix]  |          |
//             |          +---------v---------+          |
//             |                    |      LED:SET       |
//             |                    o------------------->|
//             |                    |   @ix,onoff[@ix]   |
//             |                    |                    |
//
//==============================================================================
// toggle.b (event message flow)
//
//  (A) := app;  (D) := bl_down;  (U) := bl_up;
//
//  (U) -> [BUTTON:PRESS @ix] -> (A);
//  (A) -> [LED:SET @ix,onoff[@ix]] -> (D);
//
//==============================================================================

  #include "bluccino.h"                // access Bluccino stuff

//==============================================================================
// app module (public module interface)
// - dependig on switch @ix status (0/1) de/activate blinker @ix (send ms=0/200)
//==============================================================================
// (D) := bl_down;  (U) := bl_up;
//                  +--------------------+
//                  |        app         | app module (high level)
//                  +--------------------+
//                  |       BUTTON:      | BUTTON: input interface
// (U)->    PRESS ->|         @ix        | receive button @ix press event
//                  +--------------------+
//                  |        LED:        | LED: input interface
// (D)<-   TOGGLE <-|        @-1         | toggle all LEDs
//                  +--------------------+
//==============================================================================

  int app(BL_ob *o, int val)
  {
    static BL_oval D = bl_down;                       // down gear

    switch (bl_id(o))
    {
      case BL_ID(_BUTTON,PRESS_):
        return bl_msg((D), _LED,TOGGLE_, -1,NULL,0);  // toggle all LEDs

      default:
        return -1;
    }
  }

//==============================================================================
// main function (set verbose level and run tick/tock engine)
//==============================================================================

  void main(void)
  {
    bl_hello(4,PROJECT" (press button!)");  // verbose level 4, print hello msg
    bl_engine(app,10,1000);                 // run 10ms/1000ms tic/toc engine
  }
```
