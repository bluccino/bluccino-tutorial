## CMakeLists.txt
```
# SPDX-License-Identifier: Apache-2.0

  cmake_minimum_required(VERSION 3.20.0)
  find_package(Zephyr REQUIRED HINTS $ENV{ZEPHYR_BASE})

#===============================================================================
# project personality (definitions to be pushed down to C-level)
#===============================================================================

  project(05-roulette)

  add_definitions(-DPROJECT="${CMAKE_PROJECT_NAME}")
  add_definitions(-DBL_INCLUDE="main.h")    # auto-include main.h
  add_definitions(-DCFG_LOG_GEAR=0)         # no gear logging
  add_definitions(-DCFG_LOG_LED=0)          # no LED logging
  add_definitions(-DCFG_LOG_BUTTON=0)       # no button logging

#===============================================================================
# path setup
#===============================================================================

  set (LIB ../../../lib/v1.1.0)             # library path
  set (BLU ${LIB}/bluccino)                 # Bluccino library modules
  set (HWC ${LIB}/core/hwcore/hwtiny)       # tiny hardware core
  set (SRC src)

  include_directories(${SRC} ${BLU} ${HWC})

#===============================================================================
# source files
#===============================================================================

  target_sources(app PRIVATE
    ${SRC}/main.c
    ${BLU}/bluccino.c
    ${HWC}/bl_hw.c
  )
```

## prj.conf
```kconfig
#===============================================================================
# System Stack and Work Queue Size
#===============================================================================

CONFIG_MAIN_STACK_SIZE=2048
CONFIG_SYSTEM_WORKQUEUE_STACK_SIZE=2048

#===============================================================================
# Random number support
#===============================================================================

CONFIG_BT=y                  # config Bluetooth for Zephyr random number support

#===============================================================================
# Segger RTT
#===============================================================================

CONFIG_RTT_CONSOLE=y
CONFIG_USE_SEGGER_RTT=y
CONFIG_UART_CONSOLE=n
CONFIG_LOG_BUFFER_SIZE=4096
```

## src/main.c
```c
//==============================================================================
// main.c for 05-roulette (posting custom messages)
//==============================================================================

#include "bluccino.h"                  // bluccino swiss knife
#include "bl_util.h"                   // to access bl_rand() function

//==============================================================================
// app module (public module interface)
//==============================================================================
// (M) := main;
//                  +--------------------+
//                  |        app         | app module (high level)
//                  +--------------------+
//                  |       RANDOM:      | RANDOM input interface
// (M)->   RESULT ->|  @ix,<BL_txt>,val  | receive random stuff
//                  +--------------------+
//==============================================================================

  int app(BL_ob *o, int val)
  {
    static BL_txt color[3] = {BL_R,BL_G,BL_0};

    if (bl_is(o,_RANDOM,RESULT_))  // dispatch [RANDOM:RESULT @ix,<BL_txt>,val]
    {
      int ix = bl_ix(o);           // instance index
      BL_txt data = bl_data(o);
      bl_logo(2,BL_Y"app:",o,val);
      bl_log(1, "%snumber %d - %s wins", color[ix], val, data);

      bl_led(-1,0);  bl_led(2+ix,1); // after all LEDs off set LED @ix on
    }

    return 0;
  }

//==============================================================================
// wheel module (roulette wheel - public module interface)
//==============================================================================
// (M) := main;  (A) := app
//
//                  +--------------------+
//                  |        wheel       | app module (high level)
//                  +--------------------+
//                  |       BUTTON:      | BUTTON input interface
// (U)->    PRESS ->|        @ix         | button @ix clicked
//                  +--------------------+
//                  |       RANDOM:      | RANDOM output interface
// (A)<-   RESULT <-|  @ix,<BL_txt>,val  | receive random stuff
//                  +--------------------+
//==============================================================================

  int wheel(BL_ob *o, int val)
  {
    int ix;
    BL_txt data[3] = {"red","zero","black"};
    enum color {R,G,B} cix[] = {G,R,B,R,B,R,B,R,B,R,B, B,R,B,R,B,R,B,R,
                                  R,B,R,B,R,B,R,B,R,B, B,R,B,R,B,R,B,R};
    switch (bl_id(o))
    {
      case BL_ID(_BUTTON,PRESS_):
        bl_log(2,BL_C"wheel is spinning, ball rolling ...");
        return 0;

      case BL_ID(_BUTTON,RELEASE_):
        val = bl_rand(37);             // random value 0 <= val < 37
        ix = cix[val];                 // get actual color index
        bl_msg(app, _RANDOM,RESULT_, ix,data[ix],val);  // send message to app
        return 0;

      default:
        return -1;                     // bad command
    }
  }

//==============================================================================
// main function (set verbose level and run tick/tock engine)
//==============================================================================

  void main(void)
  {
    bl_hello(4,PROJECT" (press button)");    // verbose level 4, print hello msg
    bl_init(bl_gear,wheel);                 // init bluccino, msg's go to wheel
  }
```

## src/main.h
```c
//==============================================================================
// main.h for 05-roulette (posting custom messages)
//==============================================================================
//
// roulette
//       +-------------+                  +-------------+
//       |             |  RANDOM:RESULT   |             |   LED:SET
//       |    main     |----------------->|     app     |------------>(bl_down)
//       |             | @cix,"color",val |             |   @ix,onf
//       +-------------+                  +-------------+
//
//        main                        app                        bl_down
//        (M)                         (A)                         (D)
//         |       RANDOM:RESULT       |                           |
//         o-------------------------->|          LED:SET          |
//         |     @cix,"color",val      o-------------------------->|
//         |                           |           @-1,0           |
//         |                           |                           |
//         |                           |          LED:SET          |
//         |                           o-------------------------->|
//         |                           |         @(cix+2),1        |
//
//==============================================================================
// roulette.b (event message flow)
//
//  (M) := main;  (A) := app;
//
//  (M) -> [RANDOM:RESULT @cix,"color",val] -> (A);
//
//==============================================================================

#ifndef __MAIN_H__
#define __MAIN_H__

  #define BL_CL_TEXT  {BL_CL_SYMBOLS,"RANDOM"}        // class tag text
  #define BL_OP_TEXT  {BL_OP_SYMBOLS,"RESULT"}        // opcode text

  typedef enum BL_cl  {BL_CL_ENUMS,_RANDOM} BL_cl;    // class tag enum values
  typedef enum BL_op  {BL_OP_ENUMS,RESULT_} BL_op;     // opcode enum values

#endif // __MAIN_H__
```
