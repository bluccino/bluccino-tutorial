## CMakeLists.txt
```
# SPDX-License-Identifier: Apache-2.0

  cmake_minimum_required(VERSION 3.20.0)
  find_package(Zephyr REQUIRED HINTS $ENV{ZEPHYR_BASE})

#===============================================================================
# project personality (definitions to be pushed down to C-level)
#===============================================================================

  project(04-light)

  add_definitions(-DPROJECT="${CMAKE_PROJECT_NAME}")
  add_definitions(-DCFG_LOG_GEAR=0)

#===============================================================================
# path setup
#===============================================================================

  set (LIB ../../../lib/v1.1.0)        # library path
  set (BLU ${LIB}/bluccino)            # Bluccino library modules
  set (HWC ${LIB}/core/hwcore/hwtiny)  # tiny hardware core
  set (SRC src)

  include_directories(${SRC} ${BLU} ${HWC})

#===============================================================================
# source files
#===============================================================================

  target_sources(app PRIVATE
    ${SRC}/main.c
    ${BLU}/bluccino.c
    ${HWC}/bl_hw.c
  )
```

## prj.conf
```kconfig
#===============================================================================
# System Stack and Work Queue Size
#===============================================================================

CONFIG_MAIN_STACK_SIZE=2048
CONFIG_SYSTEM_WORKQUEUE_STACK_SIZE=2048

#===============================================================================
# Random number support
#===============================================================================

CONFIG_BT=y                  # config Bluetooth for Zephyr random number support

#===============================================================================
# Segger RTT
#===============================================================================

CONFIG_UART_CONSOLE=n
CONFIG_RTT_CONSOLE=y
CONFIG_USE_SEGGER_RTT=y
CONFIG_LOG_BUFFER_SIZE=4096
```

## src/main.c
```c
//==============================================================================
// main.c for 04-light (messaging implementation basics)
//==============================================================================
//
// light control
//       +-------------+                         +-------------+
//       |             |       LIGHT:LEVEL       |             |
//       |    main     |------------------------>|     app     |
//       |             |      @ix,"room",val     |             |
//       +-------------+                         +-------------+
//
//                   main                        app
//                   (M)                         (A)
//                    |        LIGHT:LEVEL        |
//                    o-------------------------->|
//                    |      @ix,"room",val       |
//                    |                           |
//
//==============================================================================
// light.b (light control)
//
//  (M) := main;  (A) := app;
//
//  (M) -> [LIGHT:LEVEL @ix,"room",level] -> (A);
//
//==============================================================================

#include "bluccino.h"                  // bluccino swiss knife

//==============================================================================
// app module (public module interface)
//==============================================================================
// (M) := main;
//                  +--------------------+
//                  |        app         | app module (high level)
//                  +--------------------+
//                  |       LIGHT:       | LIGHT input interface
// (M)->    LEVEL ->|   @ix,"room",val   | light level control
//                  +--------------------+
//==============================================================================

  int app(BL_ob *o, int val)
  {
    if (bl_is(o,_LIGHT,LEVEL_))        // dispatch [LIGHT:LEVEL @ix,"room",val]
    {
      BL_txt room = bl_data(o);        // name of room
      int ix = bl_ix(o);               // index of luminaire
      bl_log(1, "set %s light level @%d: %d", room, ix, val);
      bl_led(ix, val>0);               // set LED @ix on (val>0) or off (val==0)
    }

    return 0;
  }

//==============================================================================
// main function (set verbose level and run tick/tock engine)
//==============================================================================

  void main(void)
  {
    bl_hello(4,PROJECT);               // verbose level 4, print hello msg
    bl_init(bl_gear,app);             // init bluccino, notifications go to app

    BL_ob oo = {_LIGHT,LEVEL_,1,"kitchen"};

    while (1)
    {
      app(&oo,7500);                   // [LIGHT:LEVEL @1,"kitchen",7500] -> app
      bl_sleep(2000);                  // sleep 2000 ms
      app(&oo,0);                      // [LIGHT:LEVEL @1,"kitchen",0] -> app
      bl_sleep(2000);                  // sleep 2000 ms
    }
  }
```
