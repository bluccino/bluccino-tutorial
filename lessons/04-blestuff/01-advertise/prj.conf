## CMakeLists.txt
```
# SPDX-License-Identifier: Apache-2.0

  cmake_minimum_required(VERSION 3.20.0)
  find_package(Zephyr REQUIRED HINTS $ENV{ZEPHYR_BASE})

#===============================================================================
# project personality (definitions to be pushed down to C-level)
#===============================================================================

  project(01-advertise)

  add_definitions(-DPROJECT="${CMAKE_PROJECT_NAME}")  # C code to see PROJECT
  add_definitions(-DCFG_LOG_BLE=1)                    # enable BLE logging
  add_definitions(-DCFG_BLE_AUTO_INIT=0)

#===============================================================================
# path setup
#===============================================================================

  set (LIB ../../../lib/v1.1.0)
  set (BLU ${LIB}/bluccino)
  set (SRC src)
  set (WLC ${LIB}/core/wlcore/bttiny)  # tiny BLE wireless core
  set (SVC ${LIB}/service)             # BLE services

  include_directories(${SRC} ${BLU} ${WLC} ${SVC})

#===============================================================================
# source files
#===============================================================================

  target_sources(app PRIVATE
    ${SRC}/main.c                      # main program
    ${SRC}/app.c                       # app module
    ${SRC}/advsvc.c                    # advertising service module

    ${BLU}/bluccino.c                  # bluccino library
    ${WLC}/bl_wl.c                     # wireless BLE core
    ${WLC}/bl_ble.c                    # BLE module
    ${SVC}/bl_eddy.c                   # Eddystone beacon BLE service
  )
```

## prj.conf
```kconfig
#===============================================================================
# Bluetooth configuration
#===============================================================================

CONFIG_BT=y
CONFIG_BT_DEVICE_NAME="01-advertise"
CONFIG_BT_DEBUG_LOG=n
```

## src/main.c
```c
//==============================================================================
// main.c for 01-advertise sample (simple advertising)
//==============================================================================

  #include "bluccino.h"
  #include "app.h"
  #include "advsvc.h"

//==============================================================================
// main function
// - set verbose level and print hello message
// - run init/tick/tock engine
//==============================================================================

  void main(void)
  {
    bl_hello(5,PROJECT);                 // verbose level 4, print hello message
    bl_service(advsvc);                  // register ADV service in WL core
    bl_engine(app,10,1000);              // run 10ms/1000ms tick/tock engine
  }
```

## src/advsvc.c
```c
//==============================================================================
// advsvc.c
// setup/provide a simple advertising service
//
// Created by Hugo Pristauz on 2022-Aug-15
// Copyright © 2022 Bluccino. All rights reserved.
//==============================================================================

  #include "bluccino.h"
  #include "bl_ble.h"
  #include "advsvc.h"

//==============================================================================
// PMI definition and logging shorthands
//==============================================================================

  #define PMI                      advsvc
  #define WHO                     "advsvc:"

  #define LOG                     LOG_CORE
  #define LOGO(lvl,col,o,val)     LOGO_CORE(lvl,col WHO,o,val)
  #define LOG0(lvl,col,o,val)     LOGO_CORE(lvl,col,o,val)

//==============================================================================
// define advertising & scan response data based on the Eddystone specification:
//==============================================================================

  #define SID         BL_SID(ADV_)               // Bluccino service ID
  #define CID         0xFFFF                     // test company ID

  #define UUID \
    BT_UUID_128_ENCODE(0x88000088, 0x0088, 0x0000, 0x8800, 0x880088008800)

  static BT_data ad[] =
         {
           BT_DATA_BYTES(BT_DATA_FLAGS, BT_LE_AD_NO_BREDR),
           BT_DATA_BYTES(BT_DATA_UUID128_ALL,UUID),
         };

  static BT_data sd[] =
         {
           BT_DATA(BT_DATA_NAME_COMPLETE,PROJECT,BL_LEN(PROJECT)),
         };

    // setup BLE service receipe to prepare for advertising start

  static BL_ble ble = {ap:BT_LE_ADV_NCONN_IDENTITY, sid:SID,
                       ad:ad, alen:BL_LEN(ad), sd:sd, slen:BL_LEN(sd)};

//==============================================================================
// handler: [BLE:SETUP @sid,<BL_ble>]  setup BLE service
//==============================================================================

  static int ble_setup(BL_ob *o, int val)
  {
    BL_ble *p = bl_bleadd(o,&ble);
    bl_log(4,BL_B "setup Simple Advertising BLE service");

    return (p->err = 0);               // setup completed without errors
  }

//==============================================================================
// Simple Advertising BLE service
//==============================================================================
//
// (W) := bl_wl;
//                  +--------------------+
//                  |       advsvc       | Simple Advertising BLE service setup
//                  +--------------------+
//                  |        SYS:        | SYS input interface
// (W)->     INIT ->|        (cb)        | module init, store cb, register svc
//                  +--------------------+
//                  |        BLE:        | BLE input interface
// (W)->    SETUP ->|   @sid,<BL_ble>    | setup Simple Advertising BLE service
//                  +--------------------+
//
//==============================================================================

  int advsvc(BL_ob *o, int val)
  {
    static BL_lib lib = {PMI,SID,NULL};  // library registering data block
    static BL_oval W = NULL;             // wireless core

    if (bl_is(o,_SYS,INIT_))
    {
      bl_log(3,BL_B"init advsvc");
      W = bl_cb(o,W,WHO"(W)");           // store address of wireless core
      return bl_lib(W,&lib);             // register service @ wireless core
    }
    else if (bl_ix(o) != SID)            // proper service ID provided?
      return -1;

      // messages are only dispatched for proper serviced ID

    switch (bl_id(o))
    {
      case BL_ID(_BLE,SETUP_):           // [BLE:SETUP @sid,<BL_ble>]
        if (bl_ix(o) == SID)
          ble_setup(o,val);              // setup BLE service
        return 0;

      default:
        return 1;                        // error: do not handle message
    }
  }
```

## src/advsvc.h
```c
//==============================================================================
// adsvc.c
// setup/provide a simple advertising service
//
// Created by Hugo Pristauz on 2022-Aug-15
// Copyright © 2022 Bluccino. All rights reserved.
//==============================================================================

#ifndef __ADVSVC_H__
#define __ADVSVC_H__

//==============================================================================
// Simple Advertising BLE service (public module interface)
//==============================================================================

  int advsvc(BL_ob *o, int val);

#endif // __ADVSVC_H__
```

## src/app.c
```c
//==============================================================================
// app.c for 01-advertise sample (simple advertising)
//==============================================================================

  #include "bluccino.h"
  #include "app.h"
  #include "bl_ble.h"

//==============================================================================
// BLE service ID and PMI definition, logging shorthands
//==============================================================================

  #define WHO  "app:"

  #define LOG                     LOG_APP
  #define LOGO(lvl,col,o,val)     LOGO_APP(lvl,col WHO,o,val)
  #define LOG0(lvl,col,o,val)     LOGO_APP(lvl,col,o,val)

  #define PMI                     app  // public module interface
  BL_PMI(PMI)                          // define static _bl_pmi() function

//==============================================================================
// app
//==============================================================================
//
// (M) := main;  (U) := bl_up;  (D) := bl_down;
//
//                  +--------------------+
//                  |        app         | application top module
//                  +--------------------+
//                  |        SYS:        | SYS input interface
// (M)->     INIT ->|        (to)        | init module, store (to) callback
// (M)->     TOCK ->|  @ix,<BL_pace>,cnt | system tock
//                  +--------------------+
//                  |        BLE:        | BLE output interface
// (D)<-   ENABLE <-|      <BL_ble>      | enable Bluetooth
// (D)<-    START <-|      <BL_ble>      | start BLE advertising
//                  +--------------------+
//
//==============================================================================

  int app(BL_ob *o, int val)
  {
    static BL_ble ble;
    static BL_oval D = bl_down;

    switch (bl_id(o))
    {
      case BL_ID(_SYS,INIT_):
        bl_log(1,BL_B"init app");
        _bl_pmi(_BLE,ENABLE_, 0,&ble,0); // enable Bluetooth
        _bl_pmi(_BLE,START_, 0,&ble,0);  // start BLE advertising
        return ble.err;

      case BL_ID(_SYS,TOCK_):
        if (bl_period(o,10000))          // every 10 seconds
          bl_log(1,"I'm alive!");        // live signal
        return 0;                        // enable Bluetooth

      case _BL_ID(_BLE,ENABLE_):         // enable BLE (Bluetooth) system
      case _BL_ID(_BLE,START_):          // start BLE advertising
        return bl_out(o,val,D);

      default:
        return -1;
    }
  }
```

## src/app.h
```c
//==============================================================================
// app.h - generic app header
//==============================================================================

#ifndef __APP_H__
#define __APP_H__

//==============================================================================
// public module interface: app
//==============================================================================

  int app(BL_ob *o, int val);

#endif // __APP_H__
```

## src/main.h
```c
//==============================================================================
// main.h for 04-advsvc sample (simple advertising)
//==============================================================================
//
// Module hierarchy and pipeline setup
//
// main => bl_engine(app,tick_ms,tock_ms)
//  |
//  +- app                                     (application)
//  |   |<==================================|
// .|.......................................|...................................
//  |                                       |
//  +- bluccino ===========================>|  (Bluccino module)
//      |                                   |
//      +- bl_top =========================>|  (top gear)
//      |   |                               |
//      |   |<========================|     |  // top gear needs some messages
//      |                             |     |
//      +- bl_up =====================|====>|  (up gear)
//      |   |
//      |   |<==============================|
//      |                                   |
//      +- bl_down                          |  (down gear)
//          |                               |
// .........|...............................|...................................
//          |                               |
//          +- bl_core ====================>|  (core system)
//              |                           |
//              +- bl_wl ==================>|  (tiny BLE wireless core)
//              |  |  |<==============|     |
//              |  |                  |     |
//              |  +- bl_ble ========>|     |  (BLE module)
//              |  +- advsvc ========>|     |  (simple advertising service)
//              |                           |
//              +- bl_hw ==================>|  (empty hardware core)
//
//==============================================================================
//
// Message Flow Chart:
//
//   main                 app                   gear
//   (M)                  (A)                  (D)(U)
//    |                    |                    |  |
// +--------------------+  |                    |  |
// | bl_service(advsvc) |  |                    |  | // register advsvc service
// +--------------------+  |                    |  |
//    |                    |                    |  |
//    |         +----------v----------+         |  | // app defines statically
//    |         |  static BL_ble ble; |         |  | // a data structure <ble>
//    |         +----------v----------+         |  | // to hold all receipe
//    |                    |                    |  |
//    |                    |      SYS:INIT      |  | // bl_engine() initializes
//    o---------------------------------------->|  | // wireless core, which re-
//    |                    |        (app)       |  | // gisters advertising svc.
//    |                    |                    |  |
//    |      SYS:INIT      |                    |  | // bl_engine() inits app
//    o------------------->|     BLE:ENABLE     |  |
//    |       (NULL)       o------------------->|  | // app asks for enabling
//    |                    |       <ble>        |  | // BLE system
//    |                    |                    |  |
//    |                    |      BLE:READY     |  | // BLE module notifies
//    |                    |<----------------------o // app that Bluetooth is
//    |                    |                    |  | // now ready
//    |         +----------v----------+         |  |
//    |         | @sid = BL_SID(ADV_) |         |  | // define BLE service ID
//    |         +----------v----------+         |  |
//    |                    |                    |  |
//    |                    |   SERVICE:SETUP    |  | // advise wireless core
//    |                    o------------------->|  | // to setup receipe <ble>
//    |                    |     @sid,<ble>     |  | // for @sid BLE service
//    |                    |                    |  |
//    |                    |     BLE:START      |  | // start BLE system by
//    |                    o------------------->|  | // running advertiser
//    |                    |       <ble>        |  | // with <ble> receipe
//    |                    |                    |  |
//
//==============================================================================
```
