## CMakeLists.txt
```
# SPDX-License-Identifier: Apache-2.0

cmake_minimum_required(VERSION 3.20.0)
find_package(Zephyr REQUIRED HINTS $ENV{ZEPHYR_BASE})

#===============================================================================
# project personality (definitions to be pushed down to C-level)
#===============================================================================

  project(05-gatt-dis)

  add_definitions(-DPROJECT="${CMAKE_PROJECT_NAME}") # C-code knows project name
  add_definitions(-DCFG_BLE_AUTO_INIT=0)
  add_definitions(-DCFG_LOG_BLE=1)                   # enable BLE logging

#===============================================================================
# path setup
#===============================================================================

  set (LIB ../../../lib/v1.1.0)
  set (BLU ${LIB}/bluccino)
  set (SRC src)
  set (WLC ${LIB}/core/wlcore/bttiny)  # tiny BLE core
  set (SVC ${LIB}/service)             # BLE services

  include_directories(${SRC} ${BLU} ${WLC} ${SVC})

#===============================================================================
# source files
#===============================================================================

  target_sources(app PRIVATE
    ${SRC}/main.c                      # main program
    ${SRC}/app.c                       # application module
    ${BLU}/bluccino.c                  # bluccino library

    ${WLC}/bl_wl.c                     # wireless BLE core
    ${WLC}/bl_ble.c                    # wireless BLE core
    ${SVC}/bl_dis.c                    # device information service
  )
```

## prj.conf
```kconfig
#===============================================================================
# Increased stack due to settings API usage
#===============================================================================

CONFIG_SYSTEM_WORKQUEUE_STACK_SIZE=2048

#===============================================================================
# Settings configuration
#===============================================================================

#CONFIG_FLASH=y
#CONFIG_FLASH_PAGE_LAYOUT=y
#CONFIG_FLASH_MAP=y
#CONFIG_NVS=y
#CONFIG_SETTINGS=y

#===============================================================================
# Bluetooth settings configuration
#===============================================================================

CONFIG_BT_KEYS_OVERWRITE_OLDEST=y
CONFIG_BT_SETTINGS=y

#===============================================================================
# Bluetooth configuration
#===============================================================================

CONFIG_BT=y
CONFIG_BT_DEVICE_NAME="05-gatt-dis"

CONFIG_BT_PERIPHERAL=y
CONFIG_BT_DEBUG_LOG=n

CONFIG_BT_DIS=y
CONFIG_BT_DIS_PNP=n
CONFIG_BT_DIS_MODEL="Bluccino Model"
CONFIG_BT_DIS_MANUF="Bluccino"

CONFIG_BT_DIS_SERIAL_NUMBER=y
CONFIG_BT_DIS_FW_REV=y
CONFIG_BT_DIS_HW_REV=y
CONFIG_BT_DIS_SW_REV=y

CONFIG_BT_DIS_SERIAL_NUMBER_STR="Bluccino Serial"
CONFIG_BT_DIS_FW_REV_STR="Bluccino Firmware"
CONFIG_BT_DIS_HW_REV_STR="Bluccino Hardware"
CONFIG_BT_DIS_SW_REV_STR="Bluccino Software"

CONFIG_BT_DEVICE_APPEARANCE=833
CONFIG_BT_DEVICE_NAME_DYNAMIC=y
CONFIG_BT_DEVICE_NAME_MAX=65
```

## src/main.c
```c
//==============================================================================
// main.c - generic main module
//==============================================================================

  #include "bluccino.h"
  #include "app.h"
  #include "bl_dis.h"

//==============================================================================
// main function
// - set verbose level and print hello message
// - run init/tick/tock engine
//==============================================================================

  void main(void)
  {
    bl_hello(4,PROJECT);                 // verbose level 4, print hello message
    bl_service(bl_dis);                  // install DIS service in WL core
    bl_engine(app,10,1000);              // run 10ms/1000ms tick/tock engine
  }
```

## src/app.c
```c
//==============================================================================
// app.c
// app code for 06-gatt-bas peripheral
//
// Created by Hugo Pristauz on 2022-Aug-23
// Copyright © 2022 Bluccino. All rights reserved.
//==============================================================================

  #include "bluccino.h"
  #include "app.h"
  #include "bl_ble.h"
  #include "bl_bas.h"                  // battery service

//==============================================================================
// BLE service ID and PMI definition, logging shorthands
//==============================================================================

  #define WHO                     "app:"

  #define LOG                     LOG_APP
  #define LOGO(lvl,col,o,val)     LOGO_APP(lvl,col WHO,o,val)
  #define LOG0(lvl,col,o,val)     LOGO_APP(lvl,col,o,val)

  #define PMI                     app  // public module interface
  BL_PMI(PMI)                          // define static _bl_pmi() function

//==============================================================================
// app
//==============================================================================
// M = main;  U = bl_up;  D = bl_down;
//
//                  +--------------------+
//                  |        app         | application top module
//                  +--------------------+
//                  |        SYS:        | SYS input interface
// (M)->     INIT ->|        (to)        | init module, store (to) callback
// (M)->     TOCK ->|  @ix,<BL_pace>,cnt | tock module
//                  +--------------------+
//                  |        BLE:        | BLE input interface
// (U)->  CONNECT ->|      <BL_conn>     | notify connection event
// (U)->   DISCON ->|  <BL_conn>,reason  | notify disconnection event
// (U)->      MTU ->|       @rx,tx       | notify MTU update
//                  |....................| BLE output interface
// (D)<-   ENABLE <-|      <BL_ble>      | enable Bluetooth
// (D)<-    START <-|      <BL_ble>      | start advertising BLE service
//                  +--------------------+
//
//==============================================================================

  int app(BL_ob *o, int val)
  {
    static BL_ble ble;

    static BL_oval D = bl_down;

    switch (bl_id(o))
    {
      case BL_ID(_SYS,INIT_):
        _bl_pmi(_BLE,ENABLE_, 0,&ble,0); // enable Bluetooth
        _bl_pmi(_BLE,START_, 0,&ble,0);
        return ble.err;

      case BL_ID(_SYS,TOCK_):
        if (bl_period(o,10000))
          LOG(1,"I'm alive!");
        return 0;

      case BL_ID(_BLE,CONNECT_):       // [BLE:CONNECT <BL_conn>]
      case BL_ID(_BLE,DISCON_):        // [BLE:DISCON  <BL_conn>,reason]
        bl_color(val?BL_0:BL_C);       // set log header color
        return 0;

      case BL_ID(_BLE,MTU_):           // [BLE:MTU  @rx,tx]
        LOGO(1,BL_M"::",o,val);
	      return 0;

      case _BL_ID(_BLE,ENABLE_):       // read my own Bluetooth MAC address
      case _BL_ID(_BLE,START_):        // start BLE advertising
        return bl_out(o,val,D);

      default:
        return BL_VOID;
    }
  }
```

## src/main.h
```c
//==============================================================================
// main.h for 05-gatt-dis sample (battery service)
//==============================================================================
//
// Module hierarchy and pipeline setup
//
// main => bl_engine(app,tick_ms,tock_ms)
//  |
//  +- app                                     (application)
//  |   |<==================================|
// .|.......................................|...................................
//  |                                       |
//  +- bluccino ===========================>|  (Bluccino module)
//      |                                   |
//      +- bl_top =========================>|  (top gear)
//      |   |                               |
//      |   |<========================|     |  // top gear needs some messages
//      |                             |     |
//      +- bl_up =====================|====>|  (up gear)
//      |   |
//      |   |<==============================|
//      |                                   |
//      +- bl_down                          |  (down gear)
//          |                               |
// .........|...............................|...................................
//          |                               |
//          +- bl_core ====================>|  (core system)
//              |                           |
//              +- bl_wl ==================>|  (tiny BLE wireless core)
//              |  |  |<==============|     |
//              |  |                  |     |
//              |  +- bl_ble ========>|     |  (BLE module)
//              |  +- bl_dis ========>|     |  (device information service)
//              |                           |
//              +- bl_hw ==================>|  (empty hardware core)
//
//==============================================================================
//
// Message Flow Chart: (note: battery service bl_bas is auto-registered by
//                            tiny Bluetooth wireless core)
//
//   main                 app                   gear
//   (M)                  (A)                  (D)(U)
//    |                    |                    |  |
//    |         +----------v----------+         |  | // app defines statically
//    |         |  static BL_ble ble; |         |  | // a data structure <ble>
//    |         +----------v----------+         |  | // to hold all receipe
//    |                    |                    |  |
//    |                    |      SYS:INIT      |  | // bl_engine() initializes
//    o---------------------------------------->|  | // wireless core, which re-
//    |                    |        (app)       |  | // gisters advertising svc.
//    |                    |                    |  |
//    |      SYS:INIT      |                    |  | // bl_engine() inits app
//    o------------------->|     BLE:ENABLE     |  |
//    |       (NULL)       o------------------->|  | // app asks for enabling
//    |                    |       <ble>        |  | // BLE system
//    |                    |                    |  |
//    |                    |      BLE:READY     |  | // BLE module notifies
//    |                    |<----------------------o // app that Bluetooth is
//    |                    |                    |  | // now ready
//    |         +----------v----------+         |  |
//    |         | @sid = BL_SID(DIS_) |         |  | // define BLE service ID
//    |         +----------v----------+         |  |
//    |                    |                    |  |
//    |                    |   SERVICE:SETUP    |  | // advise wireless core
//    |                    o------------------->|  | // to setup receipe <ble>
//    |                    |     @sid,<ble>     |  | // for @sid BLE service
//    |                    |                    |  |
//    |                    |     BLE:START      |  | // start BLE system by
//    |                    o------------------->|  | // running advertiser
//    |                    |       <ble>        |  | // with <ble> receipe
//    |                    |                    |  |
//
//==============================================================================
```
