## CMakeLists.txt
```
# SPDX-License-Identifier: Apache-2.0

cmake_minimum_required(VERSION 3.20.0)
find_package(Zephyr REQUIRED HINTS $ENV{ZEPHYR_BASE})

#===============================================================================
# project personality (definitions to be pushed down to C-level)
#===============================================================================

  project(07-nandsvc)

  add_definitions(-DPROJECT="${CMAKE_PROJECT_NAME}") # C-code knows project name
  add_definitions(-DBL_INCLUDE="main.h")             # std. include of main.h
  add_definitions(-DCFG_BLE_AUTO_INIT=0)
  add_definitions(-DCFG_LOG_BLE=1)                   # enable BLE logging

#===============================================================================
# path setup
#===============================================================================

  set (LIB ../../../lib/v1.1.0)
  set (BLU ${LIB}/bluccino)
  set (SRC src)
  set (WLC ${LIB}/core/wlcore/bttiny)  # tiny BLE core
  set (SVC ${LIB}/service)             # BLE services

  include_directories(${SRC} ${BLU} ${WLC} ${SVC})

#===============================================================================
# source files
#===============================================================================

  target_sources(app PRIVATE
    ${SRC}/main.c                      # main program
    ${SRC}/app.c                       # application module

    ${BLU}/bluccino.c                  # bluccino library
    ${BLU}/bl_deco.c                   # decorate log header

    ${WLC}/bl_wl.c                     # wireless BLE core
    ${WLC}/bl_ble.c                    # wireless BLE core
    ${SRC}/nandsvc.c                   # nand service
  )
```

## prj.conf
```kconfig
#===============================================================================
# Increased stack due to settings API usage
#===============================================================================

CONFIG_SYSTEM_WORKQUEUE_STACK_SIZE=2048

#===============================================================================
# Settings configuration
#===============================================================================

#CONFIG_FLASH=y
#CONFIG_FLASH_PAGE_LAYOUT=y
#CONFIG_FLASH_MAP=y
#CONFIG_NVS=y
#CONFIG_SETTINGS=y

#===============================================================================
# Bluetooth settings configuration
#===============================================================================

CONFIG_BT_KEYS_OVERWRITE_OLDEST=y
CONFIG_BT_SETTINGS=y

#===============================================================================
# Bluetooth configuration
#===============================================================================

CONFIG_BT=y
CONFIG_BT_DEVICE_NAME="07-nandsvc"

CONFIG_BT_DEBUG_LOG=n
CONFIG_BT_SMP=y
CONFIG_BT_SIGNING=y
CONFIG_BT_PERIPHERAL=y

CONFIG_BT_DIS=y
CONFIG_BT_ATT_PREPARE_COUNT=5
CONFIG_BT_PRIVACY=y

CONFIG_BT_DEVICE_APPEARANCE=833
CONFIG_BT_DEVICE_NAME_DYNAMIC=y
CONFIG_BT_DEVICE_NAME_MAX=65
```

## boards/nrf52dk_nrf52832.conf
```kconfig
# on nrf52dk_nrf52832 boards we have to configure Segger RTT

# configure Segger RTT
CONFIG_UART_CONSOLE=n
CONFIG_USE_SEGGER_RTT=y
CONFIG_RTT_CONSOLE=y
```

## src/main.c
```c
//==============================================================================
// main.c - generic main module
//==============================================================================

  #include "bluccino.h"
  #include "bl_deco.h"
  #include "app.h"
  #include "nandsvc.h"

//==============================================================================
// main function
// - set verbose level and print hello message
// - run init/tick/tock engine
//==============================================================================

  void main(void)
  {
    bl_hello(4,PROJECT);                 // verbose level 4, print hello message
    bl_service(nandsvc);                 // install BLE NAND service in WL core
    bl_install(bl_deco);                 // install bl_node in top gear
    bl_engine(app,10,1000);              // run 10ms/1000ms tick/tock engine
  }
```

## src/app.c
```c
//==============================================================================
// app.c for 07-nandsvc sample (NAND service peripheral)
//==============================================================================

  #include "bluccino.h"
  #include "app.h"
  #include "bl_ble.h"
  #include "nandsvc.h"

//==============================================================================
// BLE service ID and PMI definition, logging shorthands
//==============================================================================

  #define WHO  "app:"

  #define LOG                     LOG_APP
  #define LOGO(lvl,col,o,val)     LOGO_APP(lvl,col WHO,o,val)
  #define LOG0(lvl,col,o,val)     LOGO_APP(lvl,col,o,val)

  #define PMI                     app  // public module interface
  BL_PMI(PMI)                          // define static _bl_pmi() function

//==============================================================================
// helper: battery drain simulation
//==============================================================================

  static void signal_change(void)
  {
    TP_nand nand;
    _bl_pmi(_SVC,GET_, BL_SID(NAND_),&nand,0);

    nand.in1 = nand.in2 = nand.out;
    nand.out = !(nand.in1 && nand.in2);

    _bl_pmi(_SVC,SET_, BL_SID(NAND_),&nand,0);
  }

//==============================================================================
// handler: [SYS:TOCK @ix,<BL_pace>,cnt] // battery drain simulation
//==============================================================================

  static int sys_tock(BL_ob *o, int val)
  {
    if (bl_period(o,5000))             // every 5s we simulate a battery drain
      signal_change();                 // changing signal levels
    return 0;
  }

//==============================================================================
// app
//==============================================================================
//
// M = main;  U = bl_up;  D = bl_down;  T = bl_top;
//
//                  +--------------------+
//                  |        app         | application top module
//                  +--------------------+
//                  |        SYS:        | SYS input interface
// (M)->     INIT ->|        (to)        | init module, store (to) callback
// (M)->     TOCK ->|  @ix,<BL_pace>,cnt | system tock
//                  +--------------------+
//                  |        BLE:        | BLE input interface
// (U)->  CONNECT ->|      <BL_conn>     | notify connection event
// (U)->   DISCON ->|  <BL_conn>,reason  | notify disconnection event
//                  |....................| BLE output interface
// (D)<-   ENABLE <-|      <BL_ble>      | enable Bluetooth
// (D)<-    START <-|      <BL_ble>      | start BLE advertising
// (T)<-  CONNECT <-|      <BL_conn>     | notify connection event
// (T)<-   DISCON <-|  <BL_conn>,reason  | notify disconnection event
//                  +--------------------+
//                  |        SVC:        | SVC output interface
// (D)<-      GET <-|   @sid,<BL_data>   | get BLE service data
// (D)<-      SET <-|   @sid,<BL_data>   | set BLE service data
//                  +--------------------+
//
//==============================================================================

  int app(BL_ob *o, int val)
  {
    static BL_ble ble;
    static BL_oval D = bl_down;
    static BL_oval T = bl_top;

    switch (bl_id(o))
    {
      case BL_ID(_SYS,INIT_):
        bl_log(1,BL_B"init app");
        _bl_pmi(_BLE,ENABLE_, 0,&ble,0);         // enable Bluetooth
        return _bl_pmi(_BLE,START_, 0,&ble,0);   // start BLE advertising

      case BL_ID(_SYS,TOCK_):
        return sys_tock(o,val);        // enable Bluetooth

      case _BL_ID(_BLE,ENABLE_):       // enable BLE (Bluetooth) system
      case _BL_ID(_BLE,START_):        // start BLE advertising
        return bl_out(o,val,D);        // enable BLE service

      case BL_ID(_BLE,CONNECT_):       // BLE service connection
      case BL_ID(_BLE,DISCON_):        // BLE service disconnection
        return bl_out(o,val,T);        // forward to top gear

      case _BL_ID(_SVC,GET_):          // [SVC.GET @sid,<BL_data>]
      case _BL_ID(_SVC,SET_):          // [SVC.SET @sid,<BL_data>]
        return bl_out(o,val,D);        // interact with BLE service module

      default:
        return BL_VOID;
    }
  }
```

## src/app.h
```c
//==============================================================================
// app.h - generic header for app module
//==============================================================================

#ifndef __APP_H__
#define __APP_H__

//==============================================================================
// app public module interface
//==============================================================================

  int app(BL_ob *o, int val);

#endif // __APP_H__
```

## src/main.h
```c
//==============================================================================
// main.h for 07-nandsvc sample (battery service)
//==============================================================================
//
// Module hierarchy and pipeline setup
//
// main => bl_engine(app,tick_ms,tock_ms)
//  |
//  +- app                                     (application)
//  |   |<==================================|
// .|.......................................|...................................
//  |                                       |
//  +- bluccino ===========================>|  (Bluccino module)
//      |                                   |
//      +- bl_top =========================>|  (top gear)
//      |   |                               |
//      |   |<========================|     |  // top gear needs some messages
//      |                             |     |
//      +- bl_up =====================|====>|  (up gear)
//      |   |
//      |   |<==============================|
//      |                                   |
//      +- bl_down                          |  (down gear)
//          |                               |
// .........|...............................|...................................
//          |                               |
//          +- bl_core ====================>|  (core system)
//              |                           |
//              +- bl_wl ==================>|  (tiny BLE wireless core)
//              |  |  |<==============|     |
//              |  |                  |     |
//              |  +- bl_ble ========>|     |  (BLE module)
//              |  +- bl_bas ========>|     |  (battery service)
//              |                           |
//              +- bl_hw ==================>|  (empty hardware core)
//
//==============================================================================
//
// Message Flow Chart: (note: battery service bl_bas is auto-registered by
//                            tiny Bluetooth wireless core)
//
//   main                 app                   gear
//   (M)                  (A)                  (D)(U)
//    |                    |                    |  |
//    |         +----------v----------+         |  | // app defines statically
//    |         |  static BL_ble ble; |         |  | // a data structure <ble>
//    |         +----------v----------+         |  | // to hold all receipe
//    |                    |                    |  |
//    |                    |      SYS:INIT      |  | // bl_engine() initializes
//    o---------------------------------------->|  | // wireless core, which re-
//    |                    |        (app)       |  | // gisters advertising svc.
//    |                    |                    |  |
//    |      SYS:INIT      |                    |  | // bl_engine() inits app
//    o------------------->|     BLE:ENABLE     |  |
//    |       (NULL)       o------------------->|  | // app asks for enabling
//    |                    |       <ble>        |  | // BLE system
//    |                    |                    |  |
//    |                    |      BLE:READY     |  | // BLE module notifies
//    |                    |<----------------------o // app that Bluetooth is
//    |                    |                    |  | // now ready
//    |         +----------v----------+         |  |
//    |         | @sid = BL_SID(ADV_) |         |  | // define BLE service ID
//    |         +----------v----------+         |  |
//    |                    |                    |  |
//    |                    |   SERVICE:SETUP    |  | // advise wireless core
//    |                    o------------------->|  | // to setup receipe <ble>
//    |                    |     @sid,<ble>     |  | // for @sid BLE service
//    |                    |                    |  |
//    |                    |     BLE:START      |  | // start BLE system by
//    |                    o------------------->|  | // running advertiser
//    |                    |       <ble>        |  | // with <ble> receipe
//    |                    |                    |  |
//
//==============================================================================

#ifndef __MAIN_H__
#define __MAIN_H__

  #define BL_CL_TEXT  {BL_CL_SYMBOLS}                 // class tag text
  #define BL_OP_TEXT  {BL_OP_SYMBOLS,"NAND"}          // opcode text

  typedef enum BL_cl  {BL_CL_ENUMS} BL_cl;            // class tag enum values
  typedef enum BL_op  {BL_OP_ENUMS,NAND_} BL_op;      // opcode enum values

#endif // __MAIN_H__
```

## src/nandsvc.c
```c
//==============================================================================
// nandsvc.c
// BLE NAND service
//
// Created by Hugo Pristauz on 2022-Aug-23
// Copyright © 2022 Bluccino. All rights reserved.
//==============================================================================

  #include "bluccino.h"
  #include "bl_ble.h"
  #include "nandsvc.h"

//==============================================================================
// definition of PMI and logging shorthands
//==============================================================================

  #define PMI  nandsvc
  #define WHO "nandsvc:"

  #define LOG                     LOG_SVC
  #define LOGO(lvl,col,o,val)     LOGO_SVC(lvl,col WHO,o,val)
  #define LOG0(lvl,col,o,val)     LOGO_SVC(lvl,col,o,val)

//==============================================================================
// BAS module state
//==============================================================================

  static TP_nand state = { in1:0, in2:0, out:1 };

//==============================================================================
// callback: input 1 read
// - is called if central requests to read characteristics
//==============================================================================

  static ssize_t read_in1(BL_conn *conn, BL_attr *attr, void *buf,
                          BL_u16 len, BL_u16 offset)
  {
	  BL_u8 val = state.in1;

	  return bt_gatt_attr_read(conn, attr, buf, len, offset, &val, sizeof(val));
  }

//==============================================================================
// callback: input 2 read
// - is called if central requests to read characteristics
//==============================================================================

  static ssize_t read_in2(BL_conn *conn, BL_attr *attr, void *buf,
                          BL_u16 len, BL_u16 offset)
  {
	  BL_u8 val = state.in2;

	  return bt_gatt_attr_read(conn, attr, buf, len, offset, &val, sizeof(val));
  }

//==============================================================================
// callback: output read
// - is called if central requests to read characteristics
//==============================================================================

  static ssize_t read_out(BL_conn *conn, BL_attr *attr, void *buf,
                          BL_u16 len, BL_u16 offset)
  {
	  BL_u8 val = state.out;
	  return bt_gatt_attr_read(conn, attr, buf, len, offset, &val, sizeof(val));
  }

//==============================================================================
// callback:
//==============================================================================

  static void ccc_change(BL_attr *attr, BL_u16 value)
  {
	  ARG_UNUSED(attr);

	  bool notif_enabled = (value == BT_GATT_CCC_NOTIFY);
	  LOG(3,"NAND Notifications %s", notif_enabled ? "enabled" : "disabled");
  }

//==============================================================================
// service: define GATT battery service
//==============================================================================

  typedef struct bt_uuid_128 BL_uuid128;

  #define UUID128(id) \
          BT_UUID_128_ENCODE(0x88000088, 0x0088, id, 0x8800, 0x880088008800)

  #define UUID_NAND        UUID128(0x0A00)
  #define UUID_IN1         UUID128(0x0A10)
  #define UUID_IN2         UUID128(0x0A20)
  #define UUID_OUT         UUID128(0x0A30)

    // define UUIDs for GATT service and GATT characteristics

  static BL_uuid128 uuid_nand = BT_UUID_INIT_128(UUID_NAND);  // service UUID
  static BL_uuid128 uuid_in1  = BT_UUID_INIT_128(UUID_IN1);   // service UUID
  static BL_uuid128 uuid_in2  = BT_UUID_INIT_128(UUID_IN2);   // service UUID
  static BL_uuid128 uuid_out  = BT_UUID_INIT_128(UUID_OUT);   // service UUID

    // define GATT service

  BT_GATT_SERVICE_DEFINE(nand,                     // define NAND service
    BT_GATT_PRIMARY_SERVICE(&uuid_nand),           // BLE service UUID (predef.)

      // 1st characteristics: input 1

    BT_GATT_CHARACTERISTIC(                       // 1st characteristic
      &uuid_in1.uuid,                             // characteristic UUID
      BL_CHRC_RN,                                 // read/notify properties
      BL_PERM_R,                                  // read permissions
      read_in1,                                   // read callback
      NULL,                                       // write callback (not set)
      &state.in1),                                // data reference
/*
    BT_GATT_CCC(ccc_change,                       // client chrc. config change
      BL_PERM_RW),                                // read/write permissions
*/
      // 2nd characteristics: input 2

    BT_GATT_CHARACTERISTIC(                       // 2nd characteristic
      &uuid_in2.uuid,                             // characteristic UUID
      BL_CHRC_RN,                                 // read/notify properties
      BL_PERM_R,                                  // read permissions
      read_in2,                                   // read callback
      NULL,                                       // write callback (not set)
      &state.in2),                                // data reference
/*
    BT_GATT_CCC(ccc_change,                       // client chrc. config change
      BL_PERM_RW),                                // read/write permissions
*/
      // 3rd characteristics: output

    BT_GATT_CHARACTERISTIC(                       // 3rd characteristic
      &uuid_out.uuid,                             // characteristic UUID
      BL_CHRC_RN,                                 // read/notify properties
      BL_PERM_R,                                  // read permissions
      read_out,                                   // read callback
      NULL,                                       // write callback (not set)
      &state.out),                                // data reference

      // 4th characteristics: ccc

    BT_GATT_CCC(ccc_change,                       // client chrc. config change
      BL_PERM_RW),                                // read/write permissions

  );

//==============================================================================
// receipe definition
// - set up advertising data as follows:
//   1) advertising flags: general advertising, no BR/EDR support
//   2) battery service (BAS - 16 bit UUID)
//==============================================================================

  #define SID BL_SID(NAND_)                       // Bluccino service ID

	  // build-up advertising data and scan response data from data packets

  static BT_data ad[] =
  {
    BT_DATA_BYTES(BT_DATA_FLAGS, (BT_LE_AD_GENERAL | BT_LE_AD_NO_BREDR)),
    BT_DATA_BYTES(BT_DATA_UUID16_ALL, UUID_NAND),
  };
    // composition of BLE receipe

  static BL_ble ble = {ap:BT_LE_ADV_CONN_NAME, sid:SID,
                       ad:ad, alen:BL_LEN(ad)};

//==============================================================================
// handler: [BLE:SETUP @sid,<BL_ble>]  setup BLE service
//==============================================================================

  static int ble_setup(BL_ob *o, int val)
  {
    BL_ble *p = bl_blecopy(o,&ble);
    bl_log(4,BL_B "setup NAND BLE service");

    return (p->err = 0);               // setup completed without errors
  }

//==============================================================================
// handler: [SVC:GET @sid,<BL_bas>] get NAND data
//==============================================================================

  static int svc_get(BL_ob *o, int val)
  {
    TP_nand *p = bl_data(o);
    *p = state;

    LOG(4,"get: @<%s|%s>, %d & %d = %d ", BL_IDTXT(bl_ix(o)),
          state.in1, state.in2, state.out);
    return 0;
  }

//==============================================================================
// handler: [SVC:SET @sid,<BL_bas>] set NAND data
//==============================================================================

  static int svc_set(BL_ob *o, int val)
  {
    TP_nand *p = bl_data(o);

    int rc;

    state = *p;
    LOG(4,BL_M"set: @<%s|%s>, !(%d & %d) = %d (GATT notify)",
          BL_IDTXT(bl_ix(o)), state.in1, state.in2, state.out);

    rc = bt_gatt_notify(NULL, &nand.attrs[1], &state.in1, sizeof(state.in1));
    rc = bt_gatt_notify(NULL, &nand.attrs[2], &state.in2, sizeof(state.in2));
    rc = bt_gatt_notify(NULL, &nand.attrs[3], &state.out, sizeof(state.out));

    return rc == -ENOTCONN ? 0 : rc;
  }

//==============================================================================
// public module interface (PMI): Battery Service (simple BLE service)
//==============================================================================
//
// (W) := bl_wl;
//                  +--------------------+
//                  |       nandsvc       | BLE battery service
//                  +--------------------+
//                  |        SYS:        | SYS input interface
// (W)->     INIT ->|        (cb)        | module init, store cb, register svc
//                  +--------------------+
//                  |        BLE:        | BLE input interface
// (W)->    SETUP ->|    @sid,<BL_ble>   | setup Simple Advertising BLE service
//                  +--------------------+
//
//==============================================================================

  int nandsvc(BL_ob *o, int val)
  {
    static BL_lib lib = {PMI,SID,NULL};
    static BL_oval W = NULL;           // wireless core

    if (bl_is(o,_SYS,INIT_))
    {
        LOG(3,BL_B"init nandsvc");
        W = bl_cb(o,W,WHO"(W)");
        return bl_lib(W,&lib);         // register service @ parent
    }
    else if (bl_ix(o) != SID)          // proper service ID provided?
      return -1;

      // messages are only dispatched for proper serviced ID

    switch (bl_id(o))
    {
      case BL_ID(_BLE,SETUP_):         // [BLE:SETUP @sid,<BL_ble>]
        return ble_setup(o,val);       // setup BLE service

      case BL_ID(_SVC,GET_):           // [SVC:GET @sid,<BL_bas>]
        return svc_get(o,val);         // delegate to svc_get() handler

      case BL_ID(_SVC,SET_):           // [SVC:SET @sid,<BL_bas>]
        return svc_set(o,val);         // delegate to svc_set() handler

       default:
        return -1;
    }
  }
```

## src/nandsvc.h
```c
//==============================================================================
// nandsvc.h
// BLE NAND service
//
// Created by Hugo Pristauz on 2022-Aug-23
// Copyright © 2022 Bluccino. All rights reserved.
//==============================================================================

#ifndef __NANDSVC_H__
#define __NANDSVC_H__

//==============================================================================
// state data structure <MY_nand> of battery service
//==============================================================================

  typedef struct TP_nand
          {
            BL_u8 in1;
            BL_u8 in2;
            BL_u8 out;
          } TP_nand;

//==============================================================================
// public module interface (PMI): BLE battery service
//==============================================================================

  int nandsvc(BL_ob *o, int val);

#endif // __NANDSVC_H__
```
