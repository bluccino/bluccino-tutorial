## CMakeLists.txt
```
# SPDX-License-Identifier: Apache-2.0

  cmake_minimum_required(VERSION 3.20.0)
  find_package(Zephyr REQUIRED HINTS $ENV{ZEPHYR_BASE})

#===============================================================================
# project personality (definitions to be pushed down to C-level)
#===============================================================================

  project(02-ebeacon)

  add_definitions(-DPROJECT="${CMAKE_PROJECT_NAME}")  # C code to see PROJECT
  add_definitions(-DCFG_LOG_BLE=1)                    # enable BLE logging
  add_definitions(-DCFG_BLE_AUTO_INIT=0)

#===============================================================================
# path setup
#===============================================================================

  set (LIB ../../../lib/v1.1.0)
  set (BLU ${LIB}/bluccino)
  set (SRC src)
  set (WLC ${LIB}/core/wlcore/bttiny)  # tiny BLE wireless core
  set (SVC ${LIB}/service)             # BLE services

  include_directories(${SRC} ${BLU} ${WLC} ${SVC})

#===============================================================================
# source files
#===============================================================================

  target_sources(app PRIVATE
    ${SRC}/main.c                      # main program
    ${SRC}/app.c                       # app module

    ${BLU}/bluccino.c                  # bluccino library
    ${WLC}/bl_wl.c                     # wireless BLE core
    ${WLC}/bl_ble.c                    # BLE module
    ${SVC}/bl_eddy.c                   # Eddystone beacon BLE service
  )
```

## prj.conf
```kconfig
#===============================================================================
# Bluetooth configuration
#===============================================================================

CONFIG_BT=y
CONFIG_BT_DEVICE_NAME="02-ebeacon"
CONFIG_BT_DEBUG_LOG=n
#CONFIG_BT_CTLR_TX_PWR_PLUS_8
```

## src/main.c
```c
//==============================================================================
// main.c for 02-ebeacon sample (Eddystone beacon)
//==============================================================================

  #include "bluccino.h"
  #include "bl_eddy.h"
  #include "app.h"

//==============================================================================
// main function
// - set verbose level and print hello message
// - register BLE service
// - run init/tick/tock engine
//==============================================================================

  void main(void)
  {
    bl_hello(4,PROJECT);                // verbose level 4, print hello message
    bl_service(bl_eddy);                // register Eddystone service in WL core
    bl_engine(app,10,1000);             // run 10ms/1000ms tick/tock engine
  }
```

## src/app.c
```c
//==============================================================================
// app.c for 02-ebeacon sample (Eddystone beacon)
//==============================================================================

  #include "bluccino.h"
  #include "app.h"
  #include "bl_ble.h"

//==============================================================================
// BLE service ID and PMI definition, logging shorthands
//==============================================================================

  #define PMI                     app  // public module interface
  BL_PMI(PMI)                          // define static _bl_pmi() function

//==============================================================================
// app
//==============================================================================
//
// M := main;  U := bl_up;  D := bl_down;
//
//                  +--------------------+
//                  |        app         | application top module
//                  +--------------------+
//                  |        SYS:        | SYS input interface
// (M)->     INIT ->|        (to)        | init module, store (to) callback
// (M)->     TOCK ->|  @ix,<BL_pace>,cnt | system tock
//                  +--------------------+
//                  |        BLE:        | BLE output interface
// (D)<-   ENABLE <-|      <BL_ble>      | enable Bluetooth
// (D)<-    START <-|      <BL_ble>      | start BLE advertising
//                  +--------------------+
//
//==============================================================================

  int app(BL_ob *o, int val)
  {
    static BL_ble ble;
    static BL_oval D = bl_down;

    switch (bl_id(o))
    {
      case BL_ID(_SYS,INIT_):
        bl_log(1,BL_B"init app");
        _bl_pmi(_BLE,ENABLE_, 0,&ble,0);  // enable Bluetooth
        return _bl_pmi(_BLE,START_, 0,&ble,0);  // start BLE advertising

      case BL_ID(_SYS,TOCK_):
        if (bl_period(o,10000))          // every 10 seconds
          bl_log(1,"I'm alive!");        // live signal
        return 0;                        // enable Bluetooth

      case _BL_ID(_BLE,ENABLE_):         // enable BLE (Bluetooth) system
      case _BL_ID(_BLE,START_):          // start BLE advertising
        return bl_out(o,val,D);

      default:
        return -1;
    }
  }
```

## src/app.h
```c
//==============================================================================
// app.h for 01-ebeacon sample (Eddystone beacon)
//==============================================================================

#ifndef __APP_H__
#define __APP_H__

//==============================================================================
// app public module interface
//==============================================================================

  int app(BL_ob *o, int val);

#endif // __APP_H__
```

## src/main.h
```c
//==============================================================================
// main.h for 01-ebeacon demo (Eddystone beacon)
//==============================================================================
//
// Module hierarchy and pipeline setup
//
// main => bl_engine(app,tick_ms,tock_ms)
//  |
//  +- app                                     (application)
//  |   |<==================================|
// .|.......................................|...................................
//  |                                       |
//  +- bluccino ===========================>|  (Bluccino module)
//      |                                   |
//      +- bl_top =========================>|  (top gear)
//      |   |                               |
//      |   |<========================|     |  // top gear needs some messages
//      |                             |     |
//      +- bl_up =====================|====>|  (up gear)
//      |   |
//      |   |<==============================|
//      |                                   |
//      +- bl_down                          |  (down gear)
//          |                               |
// .........|...............................|...................................
//          |                               |
//          +- bl_core ====================>|  (core system)
//              |                           |
//              +- bl_wl ==================>|  (tiny BLE wireless core)
//              |  |  |<==============|     |
//              |  |                  |     |
//              |  +- bl_ble ========>|     |  (BLE module)
//              |  +- bl_eddy =======>|     |  (Eddystone BLE service)
//              |  +- bl_ibeacon ====>|     |  (iBeacon BLE service)
//              |  +- bl_bas ========>|     |  (battery BLE service)
//              |                           |
//              +- bl_hw ==================>|  (empty hardware core)
//
//==============================================================================
//
// Message Flow Chart:
//
//   main                 app                   gear
//   (M)                  (A)                  (D)(U)
//    |                    |                    |  |
//    |         +----------v----------+         |  |  // app defines statically
//    |         |  static BL_ble ble; |         |  |  // a data structure <ble>
//    |         +----------v----------+         |  |  // to hold all receipe
//    |                    |                    |  |
//    |                    |      SYS:INIT      |  |  // bl_engine() initializes
//    o---------------------------------------->|  |  // wireless core, which
//    |                    |        (app)       |  |  // registers iBeacon svc
//    |                    |                    |  |
//    |      SYS:INIT      |                    |  |  // bl_engine() inits app
//    o------------------->|     BLE:ENABLE     |  |
//    |       (NULL)       o------------------->|  |  // app asks for enabling
//    |                    |       <ble>        |  |  // BLE system
//    |                    |                    |  |
//    |                    |      BLE:READY     |  |  // BLE module notifies
//    |                    |<----------------------o  // app that Bluetooth is
//    |                    |                    |  |  // now ready
//    |                    |                    |  |
//    |                    |   SERVICE:IBEACON  |  |  // advise wireless core
//    |                    o------------------->|  |  // to setup receipe <ble>
//    |                    |       <ble>        |  |  // for iBeacon service
//    |                    |                    |  |
//    |                    |      BLE:START     |  |  // start BLE system by
//    |                    o------------------->|  |  // running advertiser
//    |                    |       <ble>        |  |  // with data from <ble>
//    |                    |                    |  |
//
//==============================================================================
```
