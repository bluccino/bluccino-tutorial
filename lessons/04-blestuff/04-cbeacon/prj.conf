## CMakeLists.txt
```
# SPDX-License-Identifier: Apache-2.0

  cmake_minimum_required(VERSION 3.20.0)
  find_package(Zephyr REQUIRED HINTS $ENV{ZEPHYR_BASE})

#===============================================================================
# project personality (definitions to be pushed down to C-level)
#===============================================================================

  project(04-cbeacon)

  add_definitions(-DPROJECT="${CMAKE_PROJECT_NAME}")  # C code to see PROJECT
  add_definitions(-DBL_INCLUDE="main.h")              # always include "main.h"
  add_definitions(-DCFG_BLE_AUTO_INIT=0)
  add_definitions(-DCFG_LOG_BLE=1)                    # enable BLE logging

#===============================================================================
# path setup
#===============================================================================

  set (LIB ../../../lib/v1.1.0)
  set (BLU ${LIB}/bluccino)
  set (SRC src)
  set (BLE ${LIB}/core/wlcore/bttiny)  # tiny BLE core
  set (SVC ${LIB}/service)             # BLE services
  set (HWC ${LIB}/core/hwcore/hwtiny)  # tiny hardware core

  include_directories(${BLU} ${SRC} ${BLE} ${SVC} ${HWC})

#===============================================================================
# source files
#===============================================================================

  target_sources(app PRIVATE
    ${SRC}/main.c                      # main program
    ${SRC}/cbeacon.c                   # Custom beacon BLE service

    ${BLU}/bluccino.c                  # bluccino library
    ${BLE}/bl_wl.c                     # wireless BLE core
    ${BLE}/bl_ble.c                    # BLE module
    ${HWC}/bl_hw.c                     # hardware core
  )
```

## prj.conf
```kconfig
#===============================================================================
# Bluetooth configuration
#===============================================================================

CONFIG_BT=y
CONFIG_BT_DEVICE_NAME="04-cbeacon"
CONFIG_BT_DEBUG_LOG=n

#===============================================================================
# Set tx power level to +4dB or to +8dB
#===============================================================================

#CONFIG_BT_CTLR_TX_PWR_PLUS_4=y
#CONFIG_BT_CTLR_TX_PWR_PLUS_8=y
```

## src/main.c
```c
//==============================================================================
// main.c for 04-cbeacon sample (Eddystone beacon)
//==============================================================================

  #include "bluccino.h"
  #include "bl_ble.h"
  #include "cbeacon.h"

//==============================================================================
// BLE service ID and PMI definition, logging shorthands
//==============================================================================

	#define PMI                     app  // public module interface
	BL_PMI(PMI)                          // define static _bl_pmi() function

//==============================================================================
// our BLE receipe for the beacon
//==============================================================================

    static BL_ble ble;

//==============================================================================
// handler: [BUTTON:PRESS @ix]
//==============================================================================

  static int button_press(BL_ob *o, int val)
  {
    size_t size = sizeof(AD_cbeacon);

      // access manufacturing data (as part of advertising data)

    AD_cbeacon *p = bl_adata(&ble,BT_DATA_MANUFACTURER_DATA,size);

    if (p)
    {
      p->major_lo = p->major_lo+1;  // increment major
      p->minor_lo = p->minor_lo+1;  // increment minor

        // retrieve current <major|minor>

      BL_word major = BL_HBLB(p->major_hi,p->major_lo);
      BL_word minor = BL_HBLB(p->minor_hi,p->minor_lo);

      bl_log(1,BL_M "new beacon ID: <0x%04X|0x%04X>",major,minor);

        // increment minor and update advertiser

      _bl_msg(PMI, _BLE,UPDATE_, 0,&ble,0);
    }
    return 0;
  }

//==============================================================================
// app
//==============================================================================
//
// M := main;  U := bl_up;  D := bl_down;
//
//                  +--------------------+
//                  |        app         | application top module
//                  +--------------------+
//                  |        SYS:        | SYS input interface
// (M)->     INIT ->|        (to)        | init module, store (to) callback
//                  +--------------------+
//                  |       BUTTON:      | BUTTON input interface
// (M)->    PRESS ->|         @ix        | notify button @ix press
//                  +--------------------+
//                  |        BLE:        | BLE output interface
// (D)<-   ENABLE <-|      <BL_ble>      | enable Bluetooth
// (D)<-    START <-|      <BL_ble>      | start BLE advertising
// (D)<-   UPDATE <-|      <BL_ble>      | update advertising data
//                  +--------------------+
//
//==============================================================================

  int app(BL_ob *o, int val)
  {
    static BL_oval D = bl_down;

    switch (bl_id(o))
    {
      case BL_ID(_SYS,INIT_):
        bl_log(1,BL_B"init app");
        _bl_msg(PMI, _BLE,ENABLE_, 0,&ble,0);  // enable Bluetooth
        _bl_pmi(_BLE,START_, 0,&ble,0);     // start BLE advertising
        return ble.err;

      case BL_ID(_SYS,TOCK_):
        if (bl_period(o,10000) || val == 0)
          bl_log(1,"press button to change beacon ID");
        return 0;

      case BL_ID(_BUTTON,PRESS_):
        return button_press(o,val);        // delegate to button_press() handler

      case _BL_ID(_BLE,ENABLE_):            // enable Bluetooth
      case _BL_ID(_BLE,START_):             // start BLE advertising
      case _BL_ID(_BLE,UPDATE_):            // update advertiser data
        return bl_out(o,val,D);

      default:
        return -1;
    }
  }

//==============================================================================
// main function
// - set verbose level and print hello message
// - run init/tick/tock engine
//==============================================================================

  void main(void)
  {
    bl_hello(4,PROJECT);                 // verbose level 4, print hello message
    bl_service(cbeacon);                 // register cBeacon service in WL core
    bl_engine(app,10,1000);              // run 10ms/1000ms tick/tock engine
  }
```

## src/cbeacon.c
```c
//==============================================================================
// cbeacon.c
// setup/provide custom cBeacon service
//
// Created by Hugo Pristauz on 2022-Aug-14
// Copyright © 2022 Bluenetics. All rights reserved.
//==============================================================================

  #include "bluccino.h"
  #include "bl_ble.h"
  #include "cbeacon.h"

//==============================================================================
// PMI definition and logging shorthands
//==============================================================================

  #define PMI                      cbeacon
  #define WHO                     "cbeacon:"

  #define LOG                     LOG_CORE
  #define LOGO(lvl,col,o,val)     LOGO_CORE(lvl,col WHO,o,val)
  #define LOG0(lvl,col,o,val)     LOGO_CORE(lvl,col,o,val)

//==============================================================================
// define advertising & scan response data based on the Eddystone specification:
// - https://github.com/google/eddystone/blob/master/protocol-specification.md
// - https://github.com/google/eddystone/tree/master/eddystone-url
//
// nRF Connect app scanner will display:
//   04-edi-beacon
//   Services: Eddystone
//   Data: http://www.bluccino.org
//   Frame Type: 0x10 (URL)
//   Service Data: Eddystone
//   0x08-2E-6F-6E-69-63-61-6C-62-00-00-10
//   Tx Power: 0 dBm
//==============================================================================

  #define EDDY_CID      0xFEAA         // Eddystone company identifier
  #define BNX_CID       0x07C6         // Bluenetics company identifier
  #define TEST_CID      0xFFFF         // Test company identifier

//==============================================================================

  #define SID         BL_ID(_SVC,CBEACON_)   // Bluccino service ID
  #define CID         BNX_CID
  #define UUID        0xFFFE                 // custom service UUID

  #define MAJOR       5
  #define MINOR       0x8888
  #define BFLAGS      0x0000

  static AD_cbeacon ad_manu =
         {
           uuid_lo:  BL_LB(CID),
           uuid_hi:  BL_HB(CID),
           major_lo: BL_LB(MAJOR),
           major_hi: BL_HB(MAJOR),
           minor_lo: BL_LB(MINOR),
           minor_hi: BL_HB(MINOR),
           nhops:    0,
           rssi0:    -60,
           bflags_lo: BL_LB(BFLAGS),
           bflags_hi: BL_HB(BFLAGS),
         };

    // build-up advertising data and scan response data from data packets

  static BT_data ad[] =                // advertising data
         {
           BT_DATA_BYTES(BT_DATA_FLAGS,BT_LE_AD_NO_BREDR),
           BT_DATA_BYTES(BT_DATA_UUID16_ALL,BL_LB(UUID),BL_HB(UUID)),
           BT_DATA(BT_DATA_MANUFACTURER_DATA, &ad_manu, sizeof(ad_manu)),
         };

  static BT_data sd[] =                // scan response data
         {
           BT_DATA(BT_DATA_NAME_COMPLETE,PROJECT,BL_LEN(PROJECT)),
         };

    // setup BLE service receipe to prepare for advertising start

  static BL_ble ble = {ap:BT_LE_ADV_NCONN_IDENTITY, sid:SID,
                       ad:ad, alen:BL_LEN(ad), sd:sd, slen:BL_LEN(sd)};

//==============================================================================
// handler: [BLE:SETUP sid,<BL_ble>] setup/return Eddystone service
//==============================================================================

  static int ble_setup(BL_ob *o, int val)
  {
    BL_ble *p = bl_blecopy(o,&ble);
    LOG(4,BL_B "setup (custom) cBeacon BLE service");

    return (p->err = 0);               // setup completed without errors
  }

//==============================================================================
// Eddystone beacon BLE service
//==============================================================================
//
// (W) := bl_wl;
//                  +--------------------+
//                  |      cbeacon       | Eddystone beacon BLE service setup
//                  +--------------------+
//                  |        SYS:        | SYS input interface
// (W)->     INIT ->|        (cb)        | module init, store cb, register svc
//                  +--------------------+
//                  |      SERVICE:      | SERVICE input interface
// (W)->  CBEACON ->|      <BL_ble>      | setup Eddystone beacon BLE service
//                  +--------------------+
//
//==============================================================================

  int cbeacon(BL_ob *o, int val)
  {
    static BL_lib lib = {PMI,SID,NULL};
    static BL_oval W = NULL;             // wireless core

    switch (bl_id(o))
    {
      case BL_ID(_SYS,INIT_):
        LOG(3,BL_B"init cbeacon");
        W = bl_cb(o,W,WHO"(W)");
        return bl_lib(W,&lib);           // register service @ parent

      case BL_ID(_BLE,SETUP_):           // setup Eddystone BLE service
        return ble_setup(o,val);

      default:
        return 1;                        // error: cannot provide
    }
  }
```

## src/cbeacon.h
```c
//==============================================================================
// cbeacon.h
// setup/provide custom cBeacon service
//
// Created by Hugo Pristauz on 2022-Aug-14
// Copyright © 2022 Bluenetics. All rights reserved.
//==============================================================================

#ifndef __BL_CBEACON_H__
#define __BL_CBEACON_H__

  typedef __struct AD_cbeacon
            {
              BL_u8   uuid_lo;           // Eddystone UUID low byte
              BL_u8   uuid_hi;           // Eddystone UUID high byte
              BL_u8   major_lo;          // major (low byte)
              BL_u8   major_hi;          // major (high byte)
              BL_u8   minor_lo;          // minor (low byte)
              BL_u8   minor_hi;          // minor (high byte)
              BL_s8   nhops;             // number of hops
              BL_s8   rssi0;             // calibrated TX power at 0m
              BL_u8   bflags_lo;         // flags (low byte)
              BL_u8   bflags_hi;         // flags (high byte)
            } AD_cbeacon;

//==============================================================================
// Eddystone beacon BLE service (public module interface)
//==============================================================================

  int cbeacon(BL_ob *o, int val);

#endif // __BL_CBEACON_H__
```

## src/main.h
```c
//==============================================================================
// main.h for 03-cbeacon demo (Eddystone beacon)
//==============================================================================
//
// Module hierarchy and pipeline setup
//
// main => bl_engine(app,tick_ms,tock_ms)
//  |
//  +- app                                     (application)
//  |   |<==================================|
// .|.......................................|...................................
//  |                                       |
//  +- bluccino ===========================>|  (Bluccino module)
//      |                                   |
//      +- bl_top =========================>|  (top gear)
//      |   |                               |
//      |   |<========================|     |  // top gear needs some messages
//      |                             |     |
//      +- bl_up =====================|====>|  (up gear)
//      |   |
//      |   |<==============================|
//      |                                   |
//      +- bl_down                          |  (down gear)
//          |                               |
// .........|...............................|...................................
//          |                               |
//          +- bl_core ====================>|  (core system)
//              |                           |
//              +- bl_wl ==================>|  (tiny BLE wireless core)
//              |  |  |<==============|     |
//              |  |                  |     |
//              |  +- bl_ble ========>|     |  (BLE module)
//              |  +- bl_eddy =======>|     |  (Eddystone BLE service)
//              |  +- bl_ibeacon ====>|     |  (iBeacon BLE service)
//              |  +- bl_bas ========>|     |  (battery BLE service)
//              |                           |
//              +- bl_hw ==================>|  (empty hardware core)
//
//==============================================================================
//
// Message Flow Chart: (note: cBeacon needs explicite registering @ bl_wl!)
//
// main            app              gear     cbeacon
// (M)             (A)             (D)(U)      (C)
//  |               |               |  |        |
//  |    +----------v----------+    |  |        |  // app defines statically
//  |    |  static BL_ble ble; |    |  |        |  // a data structure <ble>
//  |    +----------v----------+    |  |        |  // to hold all receipe
//  |               |               |  |        |
//  |               |               |  |        |  // +-----------------------+
//  |               |   SYS:INIT    |  |        |  // | explicite registering |
//  o------------------------------------------>|  // | of cbeacon @ bl_wl    |
//  |               |   (bl_wl)     |  |        |  // | (wireless core)       |
//  |               |               |  |        |  // +-----------------------+
//  |               |               |  |        |
//  |               |   SYS:INIT    |  |        |  // bl_engine() initializes
//  o------------------------------>|  |        |  // wireless core, which re-
//  |               |    (app)      |  |        |  // gisters cBeacon service
//  |               |               |  |        |
//  |   SYS:INIT    |               |  |        |  // bl_engine() inits app
//  o-------------->|  BLE:ENABLE   |  |        |
//  |    (NULL)     o-------------->|  |        |  // app asks for enabling
//  |               |    <ble>      |  |        |  // BLE system
//  |               |               |  |        |
//  |               |   BLE:READY   |  |        |  // BLE module notifies
//  |               |<-----------------o        |  // app that Bluetooth is
//  |               |               |  |        |  // now ready
//  |               |               |  |        |
//  |               |SERVICE:CBEACON|  |        |  // advise wireless core
//  |               o-------------->|  |        |  // to setup receipe <ble>
//  |               |     <ble>     |  |        |  // for cBeacon service
//  |               |               |  |        |
//  |               |  BLE:START    |  |        |  // start BLE system by
//  |               o-------------->|  |        |  // running advertiser
//  |               |    <ble>      |  |        |  // with <ble> receipe
//  |               |               |  |        |
//
//==============================================================================

#ifndef __MAIN_H__
#define __MAIN_H__

  #define BL_CL_TEXT {BL_CL_SYMBOLS}
  #define BL_OP_TEXT {BL_OP_SYMBOLS, "CBEACON"}

  typedef enum BL_cl {BL_CL_ENUMS} BL_cl;              // class tags
  typedef enum BL_op {BL_OP_ENUMS, CBEACON_} BL_op;    // opcode

#endif // __MAIN_H__
```
