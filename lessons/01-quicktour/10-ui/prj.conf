## CMakeLists.txt
```
# SPDX-License-Identifier: Apache-2.0

  cmake_minimum_required(VERSION 3.20.0)
  find_package(Zephyr REQUIRED HINTS $ENV{ZEPHYR_BASE})

#===============================================================================
# project personality (definitions to be pushed down to C-level)
#===============================================================================

  project(10-ui)

  add_definitions(-DPROJECT="${CMAKE_PROJECT_NAME}")
  add_definitions(-DCFG_LOG_BUTTON=1)        # activate button logging

#===============================================================================
# path setup
#===============================================================================

  set (LIB ../../../lib/v1.1.0)        # library path
  set (BLU ${LIB}/bluccino)            # Bluccino library modules
  set (HWC ${LIB}/core/hwcore/hwstd)   # standard hardware core
  set (SRC src)

  include_directories(${SRC} ${BLU} ${HWC})

#===============================================================================
# source files
#===============================================================================

  target_sources(app PRIVATE
    ${SRC}/main.c
    ${SRC}/blink.c
    ${BLU}/bluccino.c
    ${HWC}/bl_hw.c
  )
```

## prj.conf
```kconfig
#===============================================================================
# System Stack and Work Queue Size
#===============================================================================

CONFIG_MAIN_STACK_SIZE=2048
CONFIG_SYSTEM_WORKQUEUE_STACK_SIZE=2048

#===============================================================================
# GPIO Support
#===============================================================================

CONFIG_GPIO=y

#===============================================================================
# NVM Settings
#===============================================================================

CONFIG_BT_SETTINGS=y
CONFIG_FLASH=y
CONFIG_FLASH_PAGE_LAYOUT=y
CONFIG_FLASH_MAP=y
CONFIG_NVS=y
CONFIG_SETTINGS=y

#===============================================================================
# System Reboot
#===============================================================================

CONFIG_REBOOT=y

#===============================================================================
# Segger RTT
#===============================================================================

CONFIG_UART_CONSOLE=n
CONFIG_RTT_CONSOLE=y
CONFIG_USE_SEGGER_RTT=y
CONFIG_LOG_BUFFER_SIZE=4096
```

## src/main.c
```c
//==============================================================================
// main.c for 10-ui
//==============================================================================

  #include <zephyr/sys/reboot.h>
  #include "bluccino.h"                // access bluccino stuff
  #include "blink.h"

//==============================================================================
// shorthands
//==============================================================================

  BL_PMI(app)                          // define static inline fct. _bl_pmi()

//==============================================================================
// locals
//==============================================================================

  static int color = 4;                // instance index of red LED

//==============================================================================
// helper: get LED pattern with selected color
//==============================================================================

  static BL_txt pattern(int flashes)
  {
    static BL_txt red   = "r--r--r----------";
    static BL_txt green = "g--g--g----------";
    static BL_txt blue  = "b--b--b----------";

    flashes = BL_SAT(flashes,1,3);
    switch (color)
    {
      case 2:  return red   + (3-flashes)*3;  break;
      case 3:  return green + (3-flashes)*3;  break;
      case 4:  return blue  + (3-flashes)*3;  break;
      default: return "";
    }
  }

//==============================================================================
// handler: [BUTTON:TOCK tocks]
//==============================================================================

  static int button_tock(BL_ob *o, int val)
  {
    static int tocks = 0;              // counter for button tocks

    if (bl_ix(o) != 1)                      // ignore all buttons, except button @1
      return 0;

    bl_log(1,BL_M "button tock: %d",val);

		if (val == 0)
		{
      if (tocks < 6)
      {
        bl_log(1,BL_B "no system reboot");
        _bl_pmi(_LED,BLINK_, 0,"",0);
      }
      else if (tocks >= 6 && tocks < 11)
      {
        bl_log(1,BL_R "actual system reboot ...");
        sys_reboot(SYS_REBOOT_COLD);
      }
		  else if (tocks >= 11)
      {
        bl_log(1,BL_R "actual factory reboot ...");
        sys_reboot(SYS_REBOOT_COLD);
      }

      _bl_pmi(_LED,BLINK_, 0,"",0);    // blinker and LEDs off
		}

		tocks = val;

		if (val == 1)
		  _bl_pmi(_LED,BLINK_,0,"sssssssss-",100);
		else if (val == 4)
		  _bl_pmi(_LED,BLINK_,0,"ssss-",100);
		else if (val == 6)
    {
      bl_log(1,BL_R "performing system reset ...");
		  _bl_pmi(_LED,BLINK_,0,"wwwwwwwww-",100);
    }
		else if (val == 9)
		  _bl_pmi(_LED,BLINK_,0,"wwww-",100);
		else if (val == 11)
		{
      int starts = 0;                  // counts system starts
      int color = 4;                   // re-initialize blue color index

      bl_save("starts", &starts, sizeof(starts));
      bl_save("color", &color, sizeof(color));

		  bl_log(1,BL_R "performing factory reset ...");
		  _bl_pmi(_LED,BLINK_,0,"r-",150); // blinker (all LEDs) off
		}

		return 0;
  }

//==============================================================================
// handler: [BUTTON:CLICK @ix,n]
//==============================================================================

  static int button_click(BL_ob *o, int val)
  {
    if (bl_ix(o) == 1)             // only react on button @1
    {
      bl_log(1,BL_G "app: button @%d, %d clicks",bl_ix(o),val);
      _bl_pmi(_LED,BLINK_, 0,pattern(val),150);
    }

    if (val < 0)
    {
      color = 2 + (color % 3);
      bl_save("color", &color, sizeof(color));
      bl_log(1,BL_C "app: click/hold event: %d => next LED color",val);
      _bl_pmi(_LED,BLINK_, 0,pattern(1),150);
    }

    return 0;
  }

//==============================================================================
// handler: [SWITCH:STS sts]
//==============================================================================

  static int switch_sts(BL_ob *o, int val)
  {
    if (bl_ix(o) > 1)
    {
      bl_log(1,BL_G "app: switch @%d, status:%d",bl_ix(o),val);
      if (val == 0)                // switch @ix is off
        _bl_pmi(_LED,BLINK_, 0,"-",0);   // turn all LEDs off
      else                         // switch @ix is on
        switch (bl_ix(o))
        {
          case 2: _bl_pmi(_LED,BLINK_, 0,"r",0);  break;
          case 3: _bl_pmi(_LED,BLINK_, 0,"g",0);  break;
          case 4: _bl_pmi(_LED,BLINK_, 0,"b",0);  break;
          default: break;
        }
    }
    return 0;
  }

//==============================================================================
// handler: [SYS:INIT (cb)]
//==============================================================================

  static int sys_init(BL_ob *o, int val)
  {
     static int starts = 0;             // counts system starts
    bl_led(0,0);                       // turn status LED initially off

      // activate (3x all LEDs @ period 1s) startup blinking

    _bl_pmi(_LED,BLINK_, 0,"wwwww-----wwwww-----wwwww-----:ss------------",100);

      // load system starts counter from NVM

    bl_load("starts", &starts, sizeof(starts));
    starts++;                          // increment number of system starts
    bl_log(1,BL_M "system start: #%d",starts);

      // save system starts counter to NVM

    bl_save("starts", &starts, sizeof(starts));

      // load LED id

    bl_load("color", &color, sizeof(color));
    bl_log(1,BL_R "loaded LED @ix = %d from NVM",color);

    return 0;                          // OK
  }

//==============================================================================
// module app (PMI)
//==============================================================================
//
// M := main;  U := bl_up;  T := bl_top;
//                  +--------------------+
//                  |        APP         |
//                  +--------------------+
//                  |        SYS:        | SYS input interface
// (M)->     INIT ->|        (cb)        | init module, ignore <out> arg
//                  +--------------------+
//                  |      BUTTON:       | BUTTON input interface
// (U)->    PRESS ->|        @ix,0       | button press at time 0
// (U)->  RELEASE ->|        @ix,ms      | button release after ms
// (U)->    CLICK ->|        @ix,n       | number of button clicks
// (U)->     TOCK ->|       @ix,ms       | button tock event, every 1000 ms
//                  +--------------------+
//                  |       LED:         | LED output interface
// (T)<-    BLINK <-|  @ix,"pattern",ms  | set blink pattern
//                  +--------------------+
//
//==============================================================================

  int app(BL_ob *o, int val)           // app function, handling all messages
  {                                    // which are forwarded by Bluccino layer
    static BL_oval T = bl_top;         // top gear

    switch (bl_id(o))
    {
      case BL_ID(_SYS,INIT_):          // dispatch [SYS:INIT] event
        return sys_init(o,val);        // delegate to init handler

      case BL_ID(_BUTTON,PRESS_):      // dispatch [BUTTON:PRESS] event
        bl_logo(1,"app:ignore",o,val);
        return 0;

      case BL_ID(_BUTTON,RELEASE_):    // dispatch [BUTTON:RELEASE] event
        bl_logo(1,"app:ignore",o,val);
        return 0;

      case BL_ID(_BUTTON,CLICK_):      // dispatch [BUTTON:PRESS] event
			  return button_click(o,val);    // delegate to handler

       case BL_ID(_BUTTON,HOLD_):       // dispatch [BUTTON:HOLD] event
        if (val == 0)
        {
          bl_log(1,BL_G "app: button @%d hold => all LEDs off",bl_ix(o));
          _bl_pmi(_LED,BLINK_,0,"",0); // blinker (all LEDs) off
        }
			  return 0;

      case BL_ID(_BUTTON,TOCK_):       // dispatch [BUTTON:TOCK] event
        return button_tock(o,val);     // delegate to handler

      case BL_ID(_SWITCH,STS_):        // dispatch [SWITCH:STS sts]
        return switch_sts(o,val);

     case _BL_ID(_LED,BLINK_):        // set blink pattern
        return bl_out(o,val,(T));

      default:
        return BL_VOID;
    }
  }

//==============================================================================
// main entry point
// - set verbose level, print hello message and run init/tick/tock engine
//==============================================================================

  void main(void)
  {
    bl_hello(3,PROJECT " (click any of the buttons)");
    bl_install(blink);                 // install blink module in top gear libs
    bl_engine(app,50,1000);            // run tick/tock engine, cb's go to app
  }
```

## src/blink.c
```c
//==============================================================================
// blink.c - blink module
//==============================================================================
// module blinker (PMI)
// - [LED:BLINK @0,"s",0]              // status LED @0 on
// - [LED:BLINK @0,"-",0]              // status LED off
// - [LED:BLINK @0,"s-",500]           // blinking status LED
// - [LED:BLINK @0,"r",0]              // RGB LED red on
// - [LED:BLINK @0,"-",0]              // RGB LED off
// - [LED:BLINK @0,"rrr---:r-",500]    // init pattern "rrr---",then repeat "r-"
// - [LED:BLINK @0,"",0]               // blinker off
//==============================================================================

  #include "bluccino.h"                // access bluccino stuff
  #include "blink.h"                   // blinker module

//==============================================================================
// shorthands
//==============================================================================

  #define PMI blink                    // public module interface
  BL_PMI(PMI)                          // define static inline fct. _bl_pmi()

//==============================================================================
// locals
//==============================================================================

  static BL_txt pattern = NULL;
  static BL_txt p = NULL;
  static int period = 0;               // zero means: blinker is inactive
  static char previous = 0;

//==============================================================================
// helper: set led
//==============================================================================

  static int led(int ix, int onoff)
  {
    return _bl_pmi(_LED,SET_, ix,NULL,onoff);
  }

//==============================================================================
// helper: control leds (according to pattern character code)
//==============================================================================

   static char led_control(char c)
   {
     switch (c)
     {
       case 's': led(-1,0); led(1,1); break;     // status LED on
       case 'r': led(-1,0); led(2,1); break;     // red LED on
       case 'g': led(-1,0); led(3,1); break;     // green LED on
       case 'b': led(-1,0); led(4,1); break;     // blue LED on
       case 'w': led(-1,1); break;               // white LED (RGB) on
       default:  led(-1,0); break;               // all LEDs off
     }
     return c;
   }

//==============================================================================
// handler: [LED:BLINK @prio,"pattern",period]
//==============================================================================

  static int led_blink(BL_ob *o, int val)
  {
    if (bl_data(o) == 0)
      return bl_err(-EINVAL,"invalid pattern (NULL)");

    p = pattern = bl_data(o);
    period = p ? val : 0;
    previous = 0;
    bl_log(2,BL_Y"set blink pattern \"%s\",%d",pattern?pattern:"", period);

      // zero period means inactive blinker but 1-time immediate LED control

    if (!period)
    {
      led_control(*p);
      bl_log(2,BL_Y "blinker inactive");
    }
    return 0;
  }

//==============================================================================
// handler: [SYS:TICK (cb)]
//==============================================================================

  static int sys_tick(BL_ob *o, int val)
  {
	  if (period && p && bl_period(o,period))
	  {
	    bl_log(5,BL_G"p:\"%s\", pattern:\"%s\", period:%d", p,pattern,period);
	    if (*p == ':')               // pattern separator
	    {
	      p = pattern = p+1;         // set p and pattern to repeat part
	      bl_log(5,BL_C"p:\"%s\", pattern:\"%s\", period:%d",p,pattern,period);
	    }

	    if (!*p)
	    {
	      p = pattern;               // load repeat pattern
	      if (!*p)                   // is there an effective pattern?
	      {
	        bl_log(2,BL_Y "deactivate blinker");
	        period = 0;              // deactivate blinker if no pattern
	      }
	    }

	      // process current character of blink pattern

	    char c = *p++;               // current character of pattern
	    if (c != previous)           // is there a change?
	      previous = led_control(c); // control LED level
	  }
    return 0;
  }

//==============================================================================
// A = app;  D = bl_down;  M = main;
//                  +--------------------+
//                  |       BLINK        |
//                  +--------------------+
//                  |        SYS:        | SYS input interface
// (A)->     INIT ->|       <out>        | init module, ignore <out> arg
// (A)->     TICK ->|      @ix,cnt       | receive system ticks (50ms period)
// (M)->  INSTALL ->|                    | advise to self-install @ top gear
//                  |....................| SYS output interface
// (T)<-      LIB <-|      <BL_lib>      | register library
//                  +--------------------+
//                  |       LED:         | LED input interface
// (A)->    BLINK ->|  @ix,"pattern",ms  | set blink pattern
//                  |....................| LED output interface
// (D)<-      SET <-|     @ix,onoff      | set on/off status of LED @ix
//                  +--------------------+
//==============================================================================

  int blink(BL_ob *o, int val)
  {
    static BL_lib lib = {PMI,BL_ID(_LIB,NODE_),NULL};  // lib ID <LIB:NODE>
    static BL_oval D = bl_down;
    static BL_oval T = bl_top;

    switch (bl_id(o))
    {
      case BL_ID(_SYS,INIT_):
        return 0;

      case BL_ID(_SYS,TICK_):
        return sys_tick(o,val);        // delegate to handler

     case BL_ID(_SYS,INSTALL_):        // advise to self register @ top gear
			 bl_log(3,"install `blink` in top gear");
			 return bl_lib((T),&lib);        // register bl_node as lib @ top  gear

      case BL_ID(_LED,BLINK_):
        return led_blink(o,val);       // delegate to handler

      case _BL_ID(_LED,SET_):
        return bl_out(o,val,(D));

      default:
        return BL_VOID;
    }
  }
```

## src/blink.h
```c
//==============================================================================
// blink.h - blink module
//==============================================================================

#ifndef __BLINK_H__
#define __BLINK_H__

//==============================================================================
// public module interface
//==============================================================================

  int blink(BL_ob *o, int val);

#endif // __BLINK_H__
```
